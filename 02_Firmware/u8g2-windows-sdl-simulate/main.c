
#include "csrc/u8g2.h"
#include <stdio.h>
#include <unistd.h>

u8g2_t u8g2;

const uint8_t control[] U8X8_PROGMEM = {
    0x00,0x00,0x00,0x00,0x00,0x00,0x00,0x00,0x00,0x00,0xF0,0x01,0x00,0x00,0x00,0xF0,
    0x01,0x00,0x00,0x00,0xF0,0x01,0x00,0x00,0x00,0xFF,0xFD,0xFF,0xFF,0x0F,0xFF,0xFD,
    0xFF,0xFF,0x0F,0xFF,0xFD,0xFF,0xFF,0x0F,0xF0,0x01,0x00,0x00,0x00,0xF0,0x01,0x00,
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    0x00,0x00,0x00,0x00,/*"D:\Project\Stm32BalanceCar\03_Tools\control.bmp",0*/
};

const uint8_t wifi[] U8X8_PROGMEM = {
    0x00,0x00,0x00,0x00,0x00,0x00,0x00,0x00,0x00,0x00,0x00,0x00,0x00,0x00,0x00,0x00,
    0x00,0x00,0x00,0x00,0x00,0x00,0x00,0x00,0x00,0x00,0x00,0x00,0x00,0x00,0x00,0xFC,
    0xFF,0x0F,0x00,0x00,0xFC,0xFF,0x0F,0x00,0xC0,0x3F,0xC0,0xFF,0x00,0xC0,0x3F,0xC0,
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    0x00,0x00,0x00,0x00,/*"D:\Project\Stm32BalanceCar\03_Tools\WIFI.bmp",0*/
};

const uint8_t sys[] U8X8_PROGMEM = {
    0x00,0x00,0x00,0x00,0x00,0x00,0x00,0x00,0x00,0x00,0x00,0x00,0x00,0x00,0x00,0x00,
    0x00,0x00,0x00,0x00,0x00,0xF0,0xFF,0x03,0x00,0x00,0xF0,0xFF,0x03,0x00,0x00,0xFF,
    0xFF,0x0F,0x00,0x00,0xFF,0xFF,0x0F,0x00,0xC0,0x0F,0x00,0x3F,0x00,0xC0,0x0F,0x00,
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    0x00,0x00,0x00,0x00,/*"D:\Project\Stm32BalanceCar\03_Tools\info.bmp",0*/
};

int ui_run(short *a,short *a_trg)
{
    if(*a < *a_trg)
    {
        *a += 1;
    }
    else if( *a > *a_trg)
    {
        *a -= 1;    
    }
    else
    {
        return 0;
    }
    return 1;
}

void Draw_Control_info(int16_t control_x,int16_t control_y)
{
    u8g2_SetFont(&u8g2, u8g2_font_8x13_tf);
    uint8_t data_info[20];
    sprintf((char*)data_info,"angle:%.2f",1.2);
    u8g2_DrawStr(&u8g2, control_x , control_y+16, data_info);  
    sprintf((char*)data_info,"dis:%.2fmm",1.2);
    u8g2_DrawStr(&u8g2, control_x , control_y+32, data_info);
    sprintf((char*)data_info,"power:%.2f",1.2);
    u8g2_DrawStr(&u8g2, control_x , control_y+48, data_info);
}

void Draw_Wifi_info(int16_t wifi_x,int16_t wifi_y)
{
    u8g2_SetFont(&u8g2, u8g2_font_8x13_tf);
    uint8_t data_info[20];
    sprintf((char*)data_info,"wifi setting");
    u8g2_DrawStr(&u8g2, wifi_x , wifi_y+16, data_info);  
    sprintf((char*)data_info,"ip:192.168.4.1",1.2);
    u8g2_DrawStr(&u8g2, wifi_x , wifi_y+32, data_info);  
    sprintf((char*)data_info,"tcp port:333");
    u8g2_DrawStr(&u8g2, wifi_x , wifi_y+48, data_info);  
}

void Draw_Sys_info(int16_t sys_x,int16_t sys_y)
{
    u8g2_SetFont(&u8g2, u8g2_font_8x13_tf);
    uint8_t data_info[20];
    sprintf((char*)data_info,"author:snqx-lqh");
    u8g2_DrawStr(&u8g2, sys_x , sys_y+16, data_info);  
    sprintf((char*)data_info,"version:v1.0");
    u8g2_DrawStr(&u8g2, sys_x , sys_y+32, data_info);  
    sprintf((char*)data_info,"Thank You");
    u8g2_DrawStr(&u8g2, sys_x , sys_y+48, data_info);  
}

int main(void)
{
    int key = 0;
   
    u8g2_SetupBuffer_SDL_128x64_4(&u8g2, &u8g2_cb_r0);
    u8x8_InitDisplay(u8g2_GetU8x8(&u8g2));
    u8x8_SetPowerSave(u8g2_GetU8x8(&u8g2), 0);
    u8g2_SetFont(&u8g2, u8g2_font_t0_22_mf);

    int8_t  menu_ui_pos = 0;
    int8_t  menu_ui_state = 0;

    int16_t menu_ui_left_x = 46,menu_ui_left_y = 15;
    int16_t menu_ui_left_x_target = 46,menu_ui_left_y_target = 15;

    int8_t  info_y_pos = 0;

    int16_t control_info_x = 0,control_info_y = 64;
    int16_t control_info_x_target = 0,control_info_y_target = 64;

    int16_t wifi_info_x = 0,wifi_info_y = 64;
    int16_t wifi_info_x_target = 0,wifi_info_y_target = 64;

    int16_t sys_info_x = 0,sys_info_y = 64;
    int16_t sys_info_x_target = 0,sys_info_y_target = 64;

    for ( ; ; )
    {
        u8g2_FirstPage(&u8g2);
		do {
            u8g2_DrawStr(&u8g2, 20 , menu_ui_left_y-5, "balance car");  
            u8g2_DrawXBMP(&u8g2, menu_ui_left_x      , menu_ui_left_y, 36, 36, control);
            u8g2_DrawXBMP(&u8g2, menu_ui_left_x + 50 , menu_ui_left_y, 36, 36, wifi);
            u8g2_DrawXBMP(&u8g2, menu_ui_left_x + 100, menu_ui_left_y, 36, 36, sys);

            Draw_Control_info(control_info_x,control_info_y);
            Draw_Wifi_info(wifi_info_x,wifi_info_y);
            Draw_Sys_info(sys_info_x,sys_info_y);

            ui_run(&menu_ui_left_x,&menu_ui_left_x_target);
            ui_run(&menu_ui_left_y,&menu_ui_left_y_target);

            ui_run(&control_info_y,&control_info_y_target);
            ui_run(&wifi_info_y   ,&wifi_info_y_target);
            ui_run(&sys_info_y    ,&sys_info_y_target);
		} while (u8g2_NextPage(&u8g2));
        
        key = u8g_sdl_get_key();
        // ↑ ↓ ← → 
        if(key == 273)
        {
                                
        }else if(key == 274)
        {
             
        }else if(key == 276)
        {
            if(menu_ui_state == 0)
            {
                menu_ui_pos ++;
                if(menu_ui_pos > 2)
                {
                    menu_ui_left_x_target = 46;
                    menu_ui_pos = 0;
                }    
                else
                    menu_ui_left_x_target -= 50;  
            }else if(menu_ui_state == 1)
            {
                menu_ui_state = 0;
                menu_ui_left_y_target += 64;
                if(menu_ui_pos == 0)
                {
                    control_info_y_target += 64;
                }    
                else if(menu_ui_pos == 1)
                {
                    wifi_info_y_target += 64;
                }
                else if(menu_ui_pos == 2)
                {
                    sys_info_y_target += 64;
                }
            }           
        }else if(key == 275)
        { 
            if(menu_ui_state == 0)
            {
                menu_ui_state = 1;
                menu_ui_left_y_target -= 64;
                if(menu_ui_pos == 0)
                {
                    control_info_y_target -= 64;
                     
                }    
                else if(menu_ui_pos == 1)
                {
                    wifi_info_y_target -= 64;
                }
                else if(menu_ui_pos == 2)
                {
                    sys_info_y_target -= 64;
                }
            }     
        }
        usleep(50000);
    }
    return 0;
}
 
